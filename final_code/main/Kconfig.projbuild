## final_code/main/Kconfig.projbuild
```kconfig
menu "HTTPS Client Configuration"
    config HTTP_SERVER_ENDPOINT
        string "Target HTTPS Server Endpoint"
        default "172.20.10.4:443"
        help
            Target HTTPS endpoint for sending camera images.
            Use port 443 for standard HTTPS.
    
    config HTTP_SERVER_PATH
        string "HTTPS Server Upload Path"
        default "/upload"
        help
            Path on the server where images will be uploaded.
            
    config HTTP_CLIENT_UPLOAD_INTERVAL
        int "Upload Interval (seconds)"
        default 5
        range 1 3600
        help
            Interval between image uploads in seconds.
endmenu
```

## kaluga_lcd/main/Kconfig.projbuild
```kconfig
menu "Example Configuration"

    choice LCD_PAD_TYPE
       prompt "LCD pad type"
        default LCD_PAD_ESP32_S2_KALUGA_V1_3
        config LCD_PAD_ESP32_S2_KALUGA_V1_3
            bool "ESP32-S2-KALUGA_V1.3"
        config LCD_PAD_ESP32_S2_KALUGA_V1_2
            bool "ESP32-S2-KALUGA_V1.2"
        config LCD_PAD_ESP32_S2_KALUGA_V1_1
            bool "ESP32-S2-KALUGA_V1.1"
    endchoice

    choice LCD_VERSION

        prompt "LCD version"
        default LCD_ST7789
        config LCD_ST7789
            bool "ST7789"
        config LCD_ILI9341
            bool "ILI9341"
        help
            Set LCD version
    endchoice

    config WIFI_SSID
        string "WiFi SSID"
        default "your_ssid"
        help
            SSID of the WiFi network to connect to.

    config WIFI_PASSWORD
        string "WiFi Password"
        default "your_password"
        help
            Password of the WiFi network.

    config MQTT_BROKER_URI
        string "MQTT Broker URI"
        default "mqtt://broker.hivemq.com"
        help
            URI of the MQTT broker, e.g. mqtt://192.168.1.100 or mqtt://broker.hivemq.com

    config MQTT_TOPIC
        string "MQTT Topic to subscribe"
        default "lcd/message"
        help
            The MQTT topic this device will subscribe to and display on the LCD.

endmenu
```

## web_2/main/Kconfig.projbuild
```kconfig
menu "HTTP Client Configuration"
    config HTTP_SERVER_ENDPOINT
        string "Target HTTP Server Endpoint"
        default "170.20.10.5:8080"
        help
            Target endpoint for sending camera images.
    
    config HTTP_SERVER_PATH
        string "HTTP Server Upload Path"
        default "/upload"
        help
            Path on the server where images will be uploaded.
            
    config HTTP_CLIENT_UPLOAD_INTERVAL
        int "Upload Interval (seconds)"
        default 5
        range 1 3600
        help
            Interval between image uploads in seconds.
endmenu
```

## web_21/sdkconfig.defaults
```kconfig
CONFIG_ESPTOOLPY_FLASHSIZE_4MB=y

CONFIG_ESPTOOLPY_FLASHFREQ_80M=y
CONFIG_ESPTOOLPY_FLASHMODE_QIO=y

CONFIG_SPIRAM_SPEED_80M=y

CONFIG_ESP_WIFI_AP_SSID="Human Face Detection"

CONFIG_ESP_TASK_WDT=n

# Wait for esp-idf stable
CONFIG_BOOTLOADER_COMPILER_OPTIMIZATION_PERF=y
CONFIG_BOOTLOADER_LOG_LEVEL_NONE=y
CONFIG_SPIRAM_MEMTEST=n

CONFIG_PARTITION_TABLE_CUSTOM=y
CONFIG_PARTITION_TABLE_CUSTOM_FILENAME="partitions.csv"

# Force camera component to use legacy I2C driver to avoid conflicts with esp32_s3_eye_noglib
CONFIG_SCCB_HARDWARE_I2C_DRIVER_LEGACY=y

# Increase esp_timer stack size to prevent stack overflow during HTTP processing
CONFIG_ESP_TIMER_TASK_STACK_SIZE=8192

# Increase HTTP client receive buffer size for better performance
CONFIG_HTTP_BUF_SIZE=2048
```
